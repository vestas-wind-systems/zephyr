/*
 * Copyright (c) 2019 Vestas Wind Systems A/S
 *
 * SPDX-License-Identifier: Apache-2.0
 */

&arduino_spi {
	lmp90100: lmp90100@0 {
		compatible = "ti,lmp90100";
		reg = <0x0>;
                spi-max-frequency = <1000000>;
		label = "LMP90100";
                /* Uncomment to use IRQ instead of polling: */
		/* drdyb-gpios = <&arduino_header 15 0>; */
                #io-channel-cells = <1>;

		gpio {
			compatible = "ti,lmp90xxx-gpio";
			label = "LMP90100_GPIO";
		};
	};
};
