## boards/arm/rcar_ebisu/Kconfig.board
```kconfig
# Copyright (c) 2020 IoT.bzh
# SPDX-License-Identifier: Apache-2.0

config BOARD_RCAR_EBISU_CR7
	bool "Cortex-R7 for Renesas Ebisu"
	depends on SOC_RENESAS_RCAR_CR7
```

## boards/arm/rcar_ebisu/Kconfig.defconfig
```kconfig
# Copyright (c) 2020 IoT.bzh
# SPDX-License-Identifier: Apache-2.0

if BOARD_RCAR_EBISU_CR7
config BOARD
	default "rcar_ebisu_cr7"
endif # BOARD_RCAR_EBISU_CR7
```

## boards/arm/rcar_ebisu/rcar_ebisu_cr7_defconfig
```kconfig
CONFIG_SOC_R8A77990=y
CONFIG_SOC_SERIES_RCAR_GEN3=y
CONFIG_BOARD_RCAR_EBISU_CR7=y
CONFIG_CLOCK_CONTROL=y
CONFIG_SYS_CLOCK_HW_CYCLES_PER_SEC=32000
CONFIG_RCAR_CMT_TIMER=y
CONFIG_CONSOLE=y
CONFIG_RAM_CONSOLE=y
CONFIG_FLASH_SIZE=0
CONFIG_FLASH_BASE_ADDRESS=0
CONFIG_GPIO=y
CONFIG_GPIO_RCAR=y
CONFIG_IPM=y
CONFIG_IPM_RCAR=y
CONFIG_PINMUX=y
CONFIG_CAN=y
CONFIG_CAN_RCAR=y
```

## boards/arm/rcar_ulcb/Kconfig.board
```kconfig
# Copyright (c) 2020 IoT.bzh
# SPDX-License-Identifier: Apache-2.0

config BOARD_RCAR_ULCB_CR7
	bool "Cortex-R7 for Renesas H3ULCB"
	depends on SOC_R8A77951
```

## boards/arm/rcar_ulcb/Kconfig.defconfig
```kconfig
# Copyright (c) 2020 IoT.bzh
# SPDX-License-Identifier: Apache-2.0

if BOARD_RCAR_ULCB_CR7
config BOARD
	default "rcar_ulcb_cr7"
endif # BOARD_RCAR_ULCB_CR7
```

## boards/arm/rcar_ulcb/rcar_ulcb_cr7_defconfig
```kconfig
CONFIG_SOC_RENESAS_RCAR_CR7=y
CONFIG_BOARD_RCAR_ULCB_CR7=y
CONFIG_CONSOLE=y
CONFIG_RAM_CONSOLE=y
CONFIG_SYS_CLOCK_HW_CYCLES_PER_SEC=800000000
CONFIG_FLASH_SIZE=0
CONFIG_FLASH_BASE_ADDRESS=0
CONFIG_GPIO=y
CONFIG_GPIO_RENESAS_RCAR_GEN3=y
CONFIG_IPM=y
CONFIG_IPM_RCAR=y
CONFIG_CLOCK_CONTROL=y
CONFIG_CLOCK_CONTROL_RCAR_MSSR=y
CONFIG_PINMUX=y
CONFIG_PINMUX_RCAR=y
CONFIG_SERIAL=y
CONFIG_UART_RCAR=y
CONFIG_UART_CONSOLE=y
```

## boards/shields/tja1145a_evb/Kconfig.shield
```kconfig
# Copyright (c) 2024 Vestas Wind Systems A/S
# SPDX-License-Identifier: Apache-2.0

config SHIELD_TJA1145A_EVB
	def_bool $(shields_list_contains,tja1145a_evb)
```

## drivers/adc/Kconfig.mcux
```kconfig
# ADC configuration options

# Copyright (c) 2015 Intel Corporation
# SPDX-License-Identifier: Apache-2.0

config ADC_MCUX_ADC12
	bool "MCUX ADC12 driver"
	depends on HAS_MCUX_ADC12
	help
	  Enable the MCUX ADC12 driver.

config ADC_MCUX_ADC16
	bool "MCUX ADC16 driver"
	depends on HAS_MCUX_ADC16
	help
	  Enable the MCUX ADC16 driver.

config ADC_MCUX_LPADC
	bool "MCUX LPADC driver"
	depends on HAS_MCUX_LPADC
	help
	  Enable the MCUX LPADC driver.

config ADC_MCUX_ADC12_CALIBRATE_ON_BOOT
	bool "Perform ADC auto-calibration on boot"
	default y
	depends on ADC_MCUX_ADC12
	help
	  Perform ADC auto-calibration on boot during driver initialization.

if ADC_MCUX_ADC16

choice
	prompt "Clock Divide Selection"
	default ADC_MCUX_ADC16_CLK_DIV_RATIO_1

config ADC_MCUX_ADC16_CLK_DIV_RATIO_1
	bool "Divide ratio is 1"

config ADC_MCUX_ADC16_CLK_DIV_RATIO_2
	bool "Divide ratio is 2"

config ADC_MCUX_ADC16_CLK_DIV_RATIO_4
	bool "Divide ratio is 4"

config ADC_MCUX_ADC16_CLK_DIV_RATIO_8
	bool "Divide ratio is 8"

endchoice

choice ADC_MCUX_ADC16_VREF
	prompt "Voltage Reference Selection"
	default ADC_MCUX_ADC16_VREF_DEFAULT

config ADC_MCUX_ADC16_VREF_DEFAULT
	bool "Default voltage reference pair V_REFH and V_REFL"

config ADC_MCUX_ADC16_VREF_ALTERNATE
	bool "Alternate reference pair"

endchoice

config ADC_MCUX_ADC16_CALIBRATE_ON_BOOT
	bool "Perform ADC auto-calibration on boot"
	default y
	help
	  Perform ADC auto-calibration on boot during driver initialization.

endif # ADC_MCUX_ADC16

if ADC_MCUX_LPADC

config LPADC_DO_OFFSET_CALIBRATION
	bool "Do offset calibration"
	help
	  Do offset calibration

endif # ADC_MCUX_LPADC
```

## drivers/can/Kconfig.flexcan
```kconfig
# NXP FlexCAN configuration options

# Copyright (c) 2019-2026 Vestas Wind Systems A/S
# SPDX-License-Identifier: Apache-2.0

choice
	prompt "NXP FlexCAN"
	default CAN_MCUX_FLEXCAN
	depends on DT_HAS_NXP_FLEXCAN_ENABLED
	depends on CLOCK_CONTROL

config CAN_MCUX_FLEXCAN
	bool "MCUX backend"
	select PINCTRL
	help
	  Enable support for the NXP FlexCAN (MCUXpresso backend).

config CAN_FLEXCAN
	bool "Native backend [EXPERIMENTAL]"
	select EXPERIMENTAL
	select PINCTRL
	help
	  Enable support for the NXP FlexCAN (native backend).

endchoice

if CAN_MCUX_FLEXCAN

config CAN_MCUX_FLEXCAN_FD
	bool # hidden
	default y
	depends on DT_HAS_NXP_FLEXCAN_FD_ENABLED && CAN_FD_MODE
	help
	  Enable support for CAN FD capable NXP FlexCAN devices.

config CAN_MCUX_FLEXCAN_WAIT_TIMEOUT
	int "Maximum number of wait loop iterations"
	default 10000
	help
	  Maximum number of wait loop iterations for the MCUX FlexCAN HAL when entering/leaving
	  freeze mode.

config CAN_MCUX_FLEXCAN_MAX_FILTERS
	int "Maximum number of concurrently active RX filters"
	range 0 128
	default 5 if CAN_MCUX_FLEXCAN_FD
	default 13
	help
	  Default maximum number of concurrently active RX filters. The maximum value depends on the
	  number of available message buffers for each FlexCAN instance.

	  This default can be overridden on a per-instance basis via the "max-filters" devicetree
	  property.

	  CAN FD mode uses larger message buffers, resulting in fewer available filters.

endif # CAN_MCUX_FLEXCAN

if CAN_FLEXCAN

config CAN_FLEXCAN_FD
	bool # hidden
	default y
	depends on CAN_FD_MODE
	depends on DT_HAS_NXP_FLEXCAN_FD_ENABLED
	help
	  Enable support for CAN FD capable NXP FlexCAN devices.

config CAN_FLEXCAN_MAX_FILTERS
	int "Maximum number of concurrently active RX filters"
	range 0 128
	default 5 if CAN_FLEXCAN_FD
	default 13
	range 1 32
	help
	  Default maximum number of concurrently active RX filters. The maximum value depends on the
	  number of available message buffers for each FlexCAN instance.

	  This default can be overridden on a per-instance basis via the "max-filters" devicetree
	  property.

	  CAN FD mode uses larger message buffers, resulting in fewer available filters.

config CAN_FLEXCAN_ERRATA_5829
	bool # hidden
	default y if SOC_SERIES_IMXRT10XX
	help
	  Enable workaround for FlexCAN errata 5829.

	  FlexCAN does not transmit a frame that is enabled to be transmitted at a specific moment
	  during the arbitration process.

config CAN_FLEXCAN_ERRATA_6032
	bool # hidden
	default y if SOC_SERIES_IMXRT10XX
	help
	  Enable workaround for FlexCAN errata 6032.

	  A frame with a wrong ID or payload is transmitted into the CAN bus when the message buffer
	  under transmission is either aborted or deactivated while the CAN bus is in the bus idle
	  state.

config CAN_FLEXCAN_ERRATA_9595
	bool # hidden
	default y if SOC_SERIES_IMXRT10XX
	help
	  Enable workaround for FlexCAN errata 9595.

	  Corrupt frame possible if freeze mode or low-power mode is entered during a bus-off state.

endif # CAN_FLEXCAN
```

## drivers/can/Kconfig.mcux
```kconfig
# MCUX CAN configuration options

# Copyright (c) 2019 Vestas Wind Systems A/S
# SPDX-License-Identifier: Apache-2.0

config CAN_MCUX_MCAN
	bool "MCUX MCAN driver"
	default y
	depends on DT_HAS_NXP_LPC_MCAN_ENABLED
	depends on CLOCK_CONTROL
	select CAN_MCAN
	select PINCTRL
	select RESET
	help
	  Enable support for mcux mcan driver.
```

## drivers/can/Kconfig.rcar
```kconfig
# Reneas RCar Gen3 CAN configuration options

# Copyright (c) 2020 IoT.bzh
# SPDX-License-Identifier: Apache-2.0

config CAN_RCAR
	bool "Renesas RCar Gen3 CAN Driver"
	depends on SOC_SERIES_RCAR_GEN3
	help
	  Enable Renesas RCar Gen3 CAN Driver.

config CAN_RCAR_INT_THREAD_STACK_SIZE
	int "Stack size for interrupt handler"
	default 512
	help
	  Size of the stack used for internal thread which is ran for
	  interrupt handling and incoming packets.

config CAN_RCAR_INT_THREAD_PRIO
	int "Priority for interrupt handler"
	default 2
	help
	  Priority level of the internal thread which is ran for
	  interrupt handling and incoming packets.

config CAN_RCAR_MAX_FILTER
	int "Maximum number of concurrent active filters"
	default 5
	range 1 32
	help
	  Defines the array size of the callback/msgq pointers.
	  Must be at least the size of concurrent reads.
```

## drivers/clock_control/Kconfig.rcar
```kconfig
# Renesas RCar Gen3

# Copyright (c) 2020 IoT.bzh
# SPDX-License-Identifier: Apache-2.0

config CLOCK_CONTROL_RCAR_MSSR
	bool "RCar MSSR driver"
	depends on SOC_SERIES_RCAR_GEN3
	help
	  Enable support for Renesas RCar MSSR driver.
```

## drivers/counter/Kconfig.mcux_lpit
```kconfig
# MCUXpresso SDK Low-power Periodic Interval Timer (LPIT)

# Copyright (c) 2021 Vestas Wind Systems A/S
# SPDX-License-Identifier: Apache-2.0

config COUNTER_MCUX_LPIT
	bool "MCUX LPIT driver"
	depends on HAS_MCUX_LPIT
	help
	  Enable support for the MCUX Low-power Periodic Interrupt Timer (LPIT).
```

## drivers/display/Kconfig.rcar_display
```kconfig
# RCAR display controller configuration options

# Copyright (c) 2020 IoT.BzH
# SPDX-License-Identifier: Apache-2.0

config RCAR_DISPLAY
	bool "RCAR display driver"
	select RCAR_DISPLAY_EARLY_HOST_INIT
	help
	  Enable driver for RCAR display.

config RCAR_DISPLAY_EARLY_HOST_INIT
	bool "Enable support for already initilized display"
	help
	  This options allow to reuse a display module that is already
	  initialized by another entity.
```

## drivers/gpio/Kconfig.renesas
```kconfig
# Renesas RCAR Gen3 configuration options

# Copyright (c) 2020 IoT.bzh
# SPDX-License-Identifier: Apache-2.0

config GPIO_RENESAS_RCAR_GEN3
	bool "Renesas RCAR Gen3 GPIO"
	depends on SOC_SERIES_RCAR_GEN3
	help
	  Enable Renesas RCAR Gen3 GPIO driver.
```

## drivers/pinmux/Kconfig.rcar
```kconfig
# Renesas RCar Gen3 pinmux

# Copyright (c) 2020 IoT.bzh
# SPDX-License-Identifier: Apache-2.0

config PINMUX_RCAR
	bool "Renesas RCar Gen3 pinmux driver"
	depends on SOC_SERIES_RCAR_GEN3
	help
	  Enable the Renesas RCar Gen3 pinmux driver.
```

## drivers/sensor/lm77/Kconfig
```kconfig
# Copyright (c) 2021 Vestas Wind Systems A/S
# SPDX-License-Identifier: Apache-2.0

config LM77
	bool "LM77 Temperature Sensor"
	depends on I2C
	help
	  Enable driver for the LM77 temperature sensor.
```

## drivers/serial/Kconfig.rcar
```kconfig
# Reneas R-Car Gen3 UART configuration options

# Copyright (c) 2020 IoT.bzh
# SPDX-License-Identifier: Apache-2.0

config UART_RCAR
	bool "Renesas R-Car Gen3 UART Driver"
	select SERIAL_HAS_DRIVER
	depends on SOC_SERIES_RCAR_GEN3
	help
	  Enable Renesas R-Car Gen3 UART Driver.
```

## dts/bindings/can/renesas,rcar-gen3-can.yaml
```yaml
description: Renesas RCar Gen3 CAN controller

compatible: "renesas,rcar-gen3-can"

include: can-controller.yaml

properties:
    reg:
      required: true

    interrupts:
      required: true

    clocks:
      required: true
```

## dts/bindings/display/rcar,rcar-display.yaml
```yaml
#
# Copyright (c) 2020 IoT.bzh
#
# SPDX-License-Identifier: Apache-2.0
#

description: Renesas RCAR Display

compatible: "renesas,rcar-display"

include: [base.yaml]

properties:

    label:
      required: true

    display_path:
      type: int
      required: true
      description: Video path
```

## dts/bindings/gpio/renesas,rcar-gen3-gpio.yaml
```yaml
#
# Copyright (c) 2020 IoT.bzh
#
# SPDX-License-Identifier: Apache-2.0
#

description: Renesas RCAR Gen3 GPIO

compatible: "renesas,rcar-gen3-gpio"

include: [gpio-controller.yaml, base.yaml]

properties:
    reg:
      required: true

    label:
      required: true

    interrupts:
      required: true

    "#gpio-cells":
      const: 2

gpio-cells:
  - pin
  - flags
```

## dts/bindings/gpio/ti,lmp90xxx-gpio.yaml
```yaml
title: TI LMP90xxx AFE GPIO controller

description: TI LMP90xxx GPIO controller binding

compatible: "ti,lmp90xxx-gpio"

include: [gpio-controller.yaml, base.yaml]

parent-bus: lmp90xxx

properties:
    label:
      required: true

    "#gpio-cells":
      const: 2

gpio-cells:
  - pin
  - flags
```

## dts/bindings/i2c/renesas,rcar-gen3-i2c.yaml
```yaml
# Copyright (c) 2021, IoT.bzh
# SPDX-License-Identifier: Apache-2.0

description: Renesas R-Car Gen3 I2C controller

compatible: "resesas,rcar-gen3-i2c"

include: i2c-controller.yaml

properties:
    reg:
      required: true
```

## dts/bindings/iio/adc/ti,lmp90097.yaml
```yaml
title: Texas Instruments LMP90097 AFE

description: Texas Instruments LMP90097 AFE binding

compatible: "ti,lmp90097"

include: ti,lmp90xxx-base.yaml
```

## dts/bindings/iio/adc/ti,lmp90098.yaml
```yaml
title: Texas Instruments LMP90098 AFE

description: Texas Instruments LMP90098 AFE binding

compatible: "ti,lmp90098"

include: ti,lmp90xxx-current.yaml
```
