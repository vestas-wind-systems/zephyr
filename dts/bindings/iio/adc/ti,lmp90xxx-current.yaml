## dts/bindings/iio/adc/ti,lmp90xxx-current.yaml
```yaml
# Common fields for Texas Instruments LMP90xxx AFEs with current sources

include: ti,lmp90xxx.yaml

properties:
    rtd-current:
      type: int
      required: false
      description: RTD current in microampere
```

## dts/bindings/iio/adc/ti,lmp90xxx.yaml
```yaml
# Common fields for Texas Instruments LMP90xxx AFEs

include: adc-controller.yaml
include: spi-device.yaml

child-bus: lmp90xxx

properties:
    drdyb-gpios:
      type: phandle-array
      required: false
      description: Data Ready Bar
```

## dts/bindings/ipm/renesas,rcar-mfis.yaml
```yaml
# Copyright (c) 2020, IoT.bzh
# SPDX-License-Identifier: Apache-2.0

description: Renesas Rcar MFIS IPM Mailbox

compatible: "renesas,rcar-mfis"

include: base.yaml

properties:
  reg:
      required: true

  interrupts:
      required: true

  interrupt-names:
      required: true

  label:
      required: true
```

## dts/bindings/phy/nxp,tja1145a.yaml
```yaml
# Copyright (c) 2024 Vestas Wind Systems A/S
# SPDX-License-Identifier: Apache-2.0

description: |
  NXP TJA1145A high-speed CAN transceiver for partial networking

  Example:
    TODO

compatible: "nxp,tja1145a"

include: [ can-transceiver.yaml, spi-device.yaml ]
```

## dts/bindings/pinctrl/renesas,rcar-pinmux.yaml
```yaml
# Copyright (c) 2021 IoT.bzh
# SPDX-License-Identifier: Apache-2.0

description: Renesas R-Car pinmux node

compatible: "renesas,rcar-pinmux"

include: base.yaml

properties:
    reg:
      required: true
```

## dts/bindings/pwm/nxp,kinetis-ftm.yaml
```yaml
# Copyright (c) 2017, NXP
# SPDX-License-Identifier: Apache-2.0

description: Kinetis FTM

compatible: "nxp,kinetis-ftm"

include: [pwm-controller.yaml, base.yaml]

properties:
    reg:
      required: true

    interrupts:
      required: true

    "#pwm-cells":
      const: 3

    prescaler:
      type: int
      required: true
      enum:
        - 1
        - 2
        - 4
        - 8
        - 16
        - 32
        - 64
        - 128
      description: Input clock prescaler

pwm-cells:
  - channel
# period in terms of nanoseconds
  - period
  - flags
```

## dts/bindings/rtc/nxp,kinetis-lpit.yaml
```yaml
# Copyright 2020 Vestas Wind Systems A/S
# SPDX-License-Identifier: Apache-2.0

description: NXP Kinetis Low-power Periodic Interrupt Timer (LPIT)

compatible: "nxp,kinetis-lpit"

include: [rtc.yaml]

properties:
    reg:
      required: true

    "#address-cells":
      required: true
      const: 1

    "#size-cells":
      required: true
      const: 0

child-binding:
    description: LPIT channel configuration

    properties:
      reg:
        type: int
        required: true
        description: |
          LPIT channel number.

      nxp,trigger-select:
        type: int
        required: false
        enum:
          - 0
          - 1
          - 2
          - 3
          - 4
          - 5
          - 6
          - 7
          - 8
          - 9
          - 10
          - 11
          - 12
          - 13
          - 14
          - 15
        description: |
          LPIT trigger channel select. The number of trigger channels is SoC
          specific. Default is channel 0.

      nxp,use-internal-trigger:
        type: boolean
        required: false
        description: |
          LPIT Internal/external trigger type select. If true, the
          nxp,trigger-select is interpreted as an internal trigger channel.
          Otherwise, it is interpreted as an external trigger channel (default).

      nxp,timer-mode:
        type: string
        required: false
        enum:
          - "periodic"            # 32-bit decrementing counter
          - "dual-periodic"       # lower 16-bit decrement, then upper 16-bit
          - "trigger-accumulator" # load on 1st trig., then decrement on trigger
        description: |
          LPIT timer mode. Default is periodic timer mode.

      nxp,reload-on-trigger:
        type: boolean
        required: false
        description: |
          If true, the timer is reloaded when a trigger is detected. Default is
          false.

      nxp,stop-on-timeout:
        type: boolean
        required: false
        description: |
          If true, the timer will stop after timeout. Default is false.

      nxp,start-on-trigger:
        type: boolean
        required: false
        description: |
          If true, timer starts when a trigger is detected. Default is false.
```

## dts/bindings/sensor/lm77.yaml
```yaml
# Copyright (c) 2021 Vestas Wind Systems A/S
# SPDX-License-Identifier: UNLICENSED

description: |
  LM77 digital temperature sensor

compatible: "lm77"

include: i2c-device.yaml

properties:
    int-gpios:
      type: phandle-array
      required: false
      description: |
        Identifies the INT signal, which is active-low open drain when
        produced by the sensor.
```

## dts/bindings/serial/renesas,rcar-gen3-scif.yaml
```yaml
# Copyright (c) 2021, IoT.bzh
# SPDX-License-Identifier: Apache-2.0
#
description: Renesas R-Car Gen3 UART controller

compatible: "renesas,rcar-gen3-scif"

include: uart-controller.yaml

properties:
    reg:
      required: true

    interrupts:
      required: true

    clocks:
      required: true
```

## dts/bindings/timer/rcar,cmt.yaml
```yaml
description: Renesas RCAR CMT timer

compatible: "rcar,cmt"

include: base.yaml

properties:
    label:
      required: true

    reg:
      required: true

    clock-frequency:
      type: int
      required: true
      description: Clock frequency information for Timer operation
```

## dts/bindings/usb/zephyr,ucan.yaml
```yaml
# Copyright (c) 2022-2023 Vestas Wind Systems A/S
# SPDX-License-Identifier: Apache-2.0

description: USB UCAN USB-CAN adapter

compatible: "zephyr,ucan"

on-bus: usb
```

## dts/bindings/watchdog/nxp,kinetis-ewm.yaml
```yaml
# Copyright (c) 2020 Vestas Wind Systems A/S
# SPDX-License-Identifier: Apache-2.0

description: Kinetis External Watchdog Monitor (EWM)

compatible: "nxp,kinetis-ewm"

include: base.yaml

properties:
    reg:
      required: true

    label:
      required: true

    interrupts:
      required: true

    clocks:
      required: true

    clk-source:
      type: int
      required: false
      enum:
        - 0
        - 1
        - 2
        - 3
      description: Watchdog counter clock source

    clk-divider:
      type: int
      required: false
      description: Watchdog counter clock divider
```

## samples/shields/lmp90100_evb/rtd/sample.yaml
```yaml
sample:
  name: LMP90100 EVB RTD
tests:
  sample.shields.lmp90100_evb.rtd:
    harness: shield
    tags: shield
    depends_on: arduino_spi
```

## samples/shields/lmp90100_evb/thermocouple/sample.yaml
```yaml
sample:
  name: LMP90100 EVB thermocouple
tests:
  sample.shields.lmp90100_evb.thermocouple:
    harness: shield
    tags: shield
    depends_on: arduino_spi
```

## soc/arm/renesas/Kconfig
```kconfig
# Copyright (c) 2020 IoT.bzh
# SPDX-License-Identifier: Apache-2.0

config SOC_RENESAS_RCAR_CR7
	bool
```

## soc/arm/renesas/Kconfig.defconfig
```kconfig
# Copyright (c) 2020 IoT.bzh
# SPDX-License-Identifier: Apache-2.0

if SOC_RENESAS_RCAR_CR7

config SOC
	default "renesas"

config NUM_IRQS
       default 512

endif # SOC_RENESAS_RCAR_CR7
```

## soc/arm/renesas/Kconfig.soc
```kconfig
# Copyright (c) 2020 IoT.bzh
# SPDX-License-Identifier: Apache-2.0

config SOC_RENESAS_RCAR_CR7
	bool "Renesas RCAR Cortex R7"
	select ARM
	select CPU_CORTEX_R7
	select GIC_V2
	select CPU_HAS_DCLS
```

## soc/arm/renesas_rcar/Kconfig.defconfig
```kconfig
# SPDX-License-Identifier: Apache-2.0

source "soc/arm/renesas_rcar/*/Kconfig.defconfig.series"
```

## soc/arm/renesas_rcar/gen3/Kconfig.defconfig.r8a77990
```kconfig
# Copyright (c) 2020 IoT.bzh
# SPDX-License-Identifier: Apache-2.0

if SOC_R8A77990

config SOC
       default "r8a77990"

endif # SOC_R8A77990
```

## soc/arm/renesas_rcar/gen3/Kconfig.soc
```kconfig
# Copyright (c) 2020 IoT.bzh
# SPDX-License-Identifier: Apache-2.0

choice
	prompt "Renesas RCar SoC Selection"
	depends on SOC_SERIES_RCAR_GEN3

config SOC_R8A77951
	bool "R8A77951"

config SOC_R8A77990
	bool "R8A77990"

endchoice
```

## subsys/usb/device/class/Kconfig.ucan
```kconfig
# Copyright (c) 2022-2023 Vestas Wind Systems A/S
# SPDX-License-Identifier: Apache-2.0

DT_COMPAT_ZEPHYR_UCAN := zephyr,ucan

menuconfig USB_DEVICE_UCAN
	bool "USB UCAN Device Class support"
	default y
	depends on DT_HAS_ZEPHYR_UCAN_ENABLED
	help
	  USB UCAN device class support.

if USB_DEVICE_UCAN

module = USB_DEVICE_UCAN
module-str = usb ucan
source "subsys/logging/Kconfig.template.log_config"

config USB_DEVICE_UCAN_FW_STRING_SUPPORT
	bool "Firmware String support"
	default y
	help
	  Enable support for the USB UCAN protocol get firmware string command.

endif # USB_DEVICE_UCAN
```

## tests/lib/sys_buf/buf_simple/testcase.yaml
```yaml
common:
  tags:
    - sys_buf
tests:
  libraries.sys_buf.buf_simple:
    type: unit
```
